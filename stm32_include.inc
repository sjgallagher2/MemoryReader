-I/home/sam/Documents/Electronics/Projects/ARM/STM32F4xx/Libraries/STM32F4xx_StdPeriph_Driver/inc/ -I/home/sam/Documents/Electronics/Projects/ARM/STM32F4xx/Libraries/CMSIS/Device/ST/STM32F4xx/Include/ -I/home/sam/Documents/Electronics/Projects/ARM/STM32F4xx/Libraries/CMSIS/Include/ -I/home/sam/Documents/Electronics/Projects/ARM/STM32F4xx/Libraries/CMSIS/RTOS/Template/ -I/home/sam/Documents/Electronics/Projects/ARM/STM32F4xx/Libraries/STM32_USB_Device_Library/Core/Inc/ -I/home/sam/Documents/Electronics/Projects/ARM/STM32F4xx/Libraries/STM32_USB_HOST_Library/Core/Inc/ -I/home/sam/Documents/Electronics/Projects/ARM/STM32F4xx/Libraries/STM32_USB_OTG_Driver/inc/ -I/home/sam/Documents/Electronics/Projects/ARM/STM32F4xx/Libraries/STM32_USB_Device_Library/Class/AUDIO/Inc/ -I/home/sam/Documents/Electronics/Projects/ARM/STM32F4xx/Libraries/STM32_USB_Device_Library/Class/CDC/Inc/ -I/home/sam/Documents/Electronics/Projects/ARM/STM32F4xx/Libraries/STM32_USB_Device_Library/Class/CustomHID/Inc/ -I/home/sam/Documents/Electronics/Projects/ARM/STM32F4xx/Libraries/STM32_USB_Device_Library/Class/DFU/Inc/ -I/home/sam/Documents/Electronics/Projects/ARM/STM32F4xx/Libraries/STM32_USB_Device_Library/Class/HID/Inc/ -I/home/sam/Documents/Electronics/Projects/ARM/STM32F4xx/Libraries/STM32_USB_Device_Library/Class/MSC/Inc/ -I/home/sam/Documents/Electronics/Projects/ARM/STM32F4xx/Libraries/STM32_USB_HOST_Library/Class/AUDIO/Inc/ -I/home/sam/Documents/Electronics/Projects/ARM/STM32F4xx/Libraries/STM32_USB_HOST_Library/Class/CDC/Inc/ -I/home/sam/Documents/Electronics/Projects/ARM/STM32F4xx/Libraries/STM32_USB_HOST_Library/Class/HID/Inc/ -I/home/sam/Documents/Electronics/Projects/ARM/STM32F4xx/Libraries/STM32_USB_HOST_Library/Class/MSC/Inc/  -I/home/sam/Documents/Electronics/Projects/ARM/STM32F4xx/Libraries/STM32_USB_HOST_Library/Class/MTP/Inc/  -I/home/sam/Documents/Electronics/Projects/ARM/STM32F4xx/Libraries/BSP/STM32F401-Discovery/ -I/home/sam/Documents/Electronics/Projects/ARM/STM32F4xx/Libraries/BSP/Components/l3gd20/ -I/home/sam/Documents/Electronics/Projects/ARM/STM32F4xx/Libraries/BSP/Components/lsm303dlhc/ -I/home/sam/Documents/Electronics/Projects/ARM/STM32F4xx/Libraries/BSP/Components/Common/ -I/home/sam/Documents/Electronics/Projects/ARM/STM32F4xx/Libraries/STM32F4xx_HAL_Driver/Inc/
